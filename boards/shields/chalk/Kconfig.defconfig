## boards/shields/chalk/Kconfig.defconfig
```kconfig
if SHIELD_CHALK_LEFT

config ZMK_KEYBOARD_NAME
    default "Chalk"

config ZMK_SPLIT_ROLE_CENTRAL
    default y

endif

if SHIELD_CHALK_LEFT || SHIELD_CHALK_RIGHT

config ZMK_SPLIT
    default y

endif
```

## boards/shields/chalk/Kconfig.shield
```kconfig
config SHIELD_CHALK_LEFT
    def_bool $(shields_list_contains,chalk_left)

config SHIELD_CHALK_RIGHT
    def_bool $(shields_list_contains,chalk_right)
```
